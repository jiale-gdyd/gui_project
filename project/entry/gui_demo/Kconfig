## project/entry/gui_demo/Kconfig
```kconfig
#
# GUI Demo Kconfig
#

source "project/entry/gui_demo/lvgl/Kconfig"
source "project/entry/gui_demo/awtk/Kconfig"
source "project/entry/gui_demo/azure/Kconfig"
```

## project/entry/gui_demo/awtk/Kconfig
```kconfig
#
# AWTK GUI Demo Kconfig
#

menu "AWTK GUI Demo Menu"

choice
    prompt "awtk demo choice"
    depends on AWTK
    default AWTK_UNK_TEST

    config AWTK_UI_DEMO
        bool "awtk ui demo"

    config AWTK_DESKTOP_DEMO
        bool "awtk desktop demo"

    config AWTK_ANIMATOR_DEMO
        bool "awtk animator demo"

    config AWTK_UNK_TEST
        bool "awtk unknown test"

endchoice

endmenu
```

## project/entry/gui_demo/azure/Kconfig
```kconfig
#
# azure-rtos GUIX Demo Kconfig
#

menu "AZURE-RTOS GUIX Demo Menu"

choice
    depends on AZURE_GUIX
    prompt "azure-rtos guix demo choice"
    default AZURE_GUIX_SIMPLE

    config AZURE_GUIX_SIMPLE
        bool "azure-rtos guix simple test"

    config AZURE_GUIX_INDUSTRIAL
        bool "azure-rtos guix industrial test"

    config AZURE_GUIX_CALCULATOR
        bool "azure-rtos guix calculator test"

    config AZURE_GUIX_WIDGET_TYPES
        bool "azure-rtos guix widget types test"

    config AZURE_GUIX_WASHING_MACHINE
        bool "azure-rtos guix washing machine test"

    config AZURE_GUIX_THERMOSTAT
        bool "azure-rtos guix thermostat test"

    config AZURE_GUIX_SPRITE
        bool "azure-rtos guix sprites test"

    config AZURE_GUIX_SMART_WATCH
        bool "azure-rtos guix smart watch test"

    config AZURE_GUIX_SHAPES
        bool "azure-rtos guix shapes test"

    config AZURE_GUIX_MEDICAL
        bool "azure-rtos guix medical test"

    config AZURE_GUIX_KEYBOARD
        bool "azure-rtos guix keyboard test"

    config AZURE_GUIX_HOME_AUTOMATION
        bool "azure-rtos guix home automation test"

    config AZURE_GUIX_CAR_INFOTAINMENT
        bool "azure-rtos guix infotainment test"

    config AZURE_GUIX_WIDGET_ANIMATION
        bool "azure-rtos guix widget animation test"

endchoice

endmenu
```

## project/entry/gui_demo/lvgl/Kconfig
```kconfig
#
# LVGL GUI Demo Kconfig
#

menu "LVGL GUI Demo Menu"

choice
    prompt "LittlevGL demo choice"
    default LVGL_BENCHMARK_TEST

    config LVGL_BENCHMARK_TEST
        bool "LittlevGL benchmark test"

    config LVGL_STRESS_TEST
        bool "LittlevGL stress test"

    config LVGL_WIDGET_TEST
        bool "LittlevGL widget test"

    config LVGL_MUSIC_TEST
        bool "LittlevGL music test"

    config LVGL_KEYPAD_ENCODER_TEST
        bool "LittlevGL keypad test"

    config LVGL_MULTILANG_TEST
        bool "LittlevGL multilang test"

    config LVGL_TRANSFORM_TEST
        bool "LittlevGL transform test"

    config LVGL_FLEX_LAYOUT_TEST
        bool "LittlevGL flex layout test"

    config LVGL_SCROLL_TEST
        bool "LittlevGL scroll test"
endchoice

endmenu
```

## project/gui/Kconfig
```kconfig
#
# GUI Kconfig
#

menu "embedded gui"

config GUI
    bool "use embedded gui"
    default n
    help
      gui

config DRM_DISP_DRIVER
    bool "Direct Rendering Manger display driver"
    select LIBDRM
    depends on GUI
    default n
    help
      DRM display driver

config FBDEV_DISP_DRIVER
    bool "framebuffer display driver"
    depends on GUI
    default n
    help
      framebuffer display driver

config X11_DISP_DRIVER
    bool "x11 window display driver"
    depends on GUI && LINUX_GNU
    default n
    help
      x11 window display driver

config WAYLAND_DISP_DRIVER
    bool "wayland display driver"
    depends on GUI
    default n
    help
      wayland display driver

source "project/gui/lvgl/Kconfig"
source "project/gui/awtk/Kconfig"
source "project/gui/azure/Kconfig"

endmenu
```

## project/gui/awtk/Kconfig
```kconfig
#
# AWTK Kconfig
#

menu "Toolkit AnyWhere"

config AWTK
    bool "Toolkit AnyWhere"
    depends on GUI
    default n
    help
      AWTK, the abbreviation of Toolkit AnyWhere, is an open source GUI engine developed by ZLG.
      It is a cross-platform GUI engine for embedded systems, WEB, mini programs, mobile phones and PC.
      It is a powerful, efficient, reliable and easy-to-use GUI engine for users to design beautiful GUI applications

config TSLIB
    bool "touch screen library"
    depends on AWTK
    default n
    help
      touch screen library

endmenu
```

## project/gui/azure/Kconfig
```kconfig
#
# Azure-rtos Kconfig
#

menu "Azure RTOS THREADX and GUIX"

config AZURE_THREADX
    bool "Azure RTOS ThreadX"
    depends on GUI
    default n
    help
      This advanced real-time operating system (RTOS) is designed specifically for deeply embedded applications.
      Among the multiple benefits it provides are advanced scheduling facilities, message passing, interrupt management,
      and messaging services. Azure RTOS ThreadX has many advanced features, including picokernel architecture,
      preemption threshold, event chaining, and a rich set of system services.

config AZURE_GUIX
    bool "Azure RTOS GUIX"
    select AZURE_THREADX
    default n
    help
      Azure RTOS GUIX is a professional-quality package, created to meet the needs of embedded systems developers.
      Unlike alternative GUI solutions Azure RTOS GUIX is small, fast, and easily ported to virtually any hardware
      configuration that’s capable of supporting graphical output. Azure RTOS GUIX also delivers exceptional visual
      appeal and an intuitive and powerful API for application-level user interface development.

endmenu
```

## project/gui/lvgl/Kconfig
```kconfig
#
# LittlevGL Kconfig
#

menu "LittlevGL"

config LVGL
    bool "Light and Versatile Embedded Graphics Library"
    depends on GUI
    default n
    help
      Light and Versatile Embedded Graphics Library

endmenu
```

## project/platform/Kconfig
```kconfig
#
# Project Kconfig
#

menu "Hardware platform"

choice
    prompt "ARM Cortex Architecture"
    default LINUX_GNU

    config CORTEX_A5
        bool "ARM Cortex A5"

    config CORTEX_A7
        bool "ARM Cortex A7"

    config CORTEX_A8
        bool "ARM Cortex A8"

    config CORTEX_A9
        bool "ARM Cortex A9"

    config CORTEX_A34
        bool "ARM Cortex A34"

    config CORTEX_A35
        bool "ARM Cortex A35"

    config CORTEX_A53
        bool "ARM Cortex A53"

    config CORTEX_A55
        bool "ARM Cortex A55"

    config CORTEX_A57
        bool "ARM Cortex A57"

    config CORTEX_A65
        bool "ARM Cortex A65"

    config CORTEX_A72
        bool "ARM Cortex A72"

    config CORTEX_A73
        bool "ARM Cortex A73"

    config CORTEX_A75
        bool "ARM Cortex A75"

    config CORTEX_A76
        bool "ARM Cortex A76"

    config CORTEX_A77
        bool "ARM Cortex A77"

    config CORTEX_A78
        bool "ARM Cortex A78"

    config LINUX_GNU
        bool "Linux GNU (eg. Ubuntu/Debian)"
endchoice

choice
    prompt "Hardware Architecture choice"
    default X86_64

    config AARCH32
        bool "aarch32 platform"

    config AARCH64
        bool "aarch64 platform"

    config X86_64
        bool "x86_64 platform"
endchoice

source "project/platform/nxp/Kconfig"
source "project/platform/rockchip/Kconfig"

endmenu
```

## project/platform/axera/Kconfig
```kconfig
#
# AXera Soc Vensor Kconfig
# 

menu "AXera Soc"

config AXERA
    bool "AXera"
    default n
    help
      https://www.axera-tech.com

choice
    prompt "AXera soc choice"
    depends on AXERA
    default AX620A

    config AX620A
        bool "Quad Core Cortex-A7"
        select AARCH32
        select CORTEX_A7

    config AX630A
        bool "Quad Core Cortex-A53"
        select AARCH32
        select CORTEX_A53
endchoice

endmenu
```

## project/platform/nxp/Kconfig
```kconfig
#
# NXP Soc Vensor Kconfig
# 

menu "NXP Semiconductors Soc"

config NXP
    bool "freescale"
    default n
    help
      Nxp Semiconductors N.V.

choice
    prompt "NXP soc choice"
    depends on NXP
    default IMX6ULL

    config IMX6ULL
        bool "i.MX 6UltraLite"
        select AARCH32
        select CORTEX_A7

    config IMX6Q
        bool "i.MX 6Quad"
        select AARCH32
        select CORTEX_A9
endchoice

endmenu
```

## project/platform/rockchip/Kconfig
```kconfig
#
# Rockchip Soc Vensor Kconfig
# 

menu "Rockchip Soc"

config ROCKCHIP
    bool "Rockchip"
    default n
    help
      Rockchip Electronics Co., Ltd

choice
    prompt "Rockchip soc choice"
    depends on ROCKCHIP
    default RV11XX

    config RV11XX
        bool "rv1126 or rv1109"
        select AARCH32

    config RK3399
        bool "rockchip 3399 chip"
        select AARCH64

    config RK3568
        bool "rockchip 3568 chip"
        select AARCH64

    config RK3588
        bool "rockchip 3588 chip"
        select AARCH64
endchoice

endmenu
```

## project/unittest/Kconfig
```kconfig
#
# Project unitTest Kconfig
#

menu "platform unittest"

config UNITTEST
    bool "platform unittest"
    default n
    help
        Enable platform unittest.

source "project/unittest/host/Kconfig"
source "project/unittest/rockchip/Kconfig"

endmenu
```

## project/unittest/host/Kconfig
```kconfig
#
# host unittest Kconfig
#

source "project/unittest/host/rtsp/Kconfig"
source "project/unittest/host/libdrm/Kconfig"
source "project/unittest/host/live555/Kconfig"
source "project/unittest/host/signalslot/Kconfig"
```

## project/unittest/host/boost/Kconfig
```kconfig
#
# boost unittest Kconfig
#

menu "host boost unittest menu"

config HOST_UNITTEST_BOOST
    bool "host boost unittest"
    default n
    help
      host boost unittest

choice
    prompt "host boost unittest demo"
    depends on X86_64 && UNITTEST
    default HOST_LIBDRM_UNKNOWN

    config HOST_BOOST_SIGNAL_SLOTS
        bool "host boost unittest signal slots demo"

    config HOST_BOOST_UNKNOWN
        bool "host boost unittest unknow demo"

endchoice

endmenu
```

## project/unittest/host/libdrm/Kconfig
```kconfig
#
# host libdrm unittest Kconfig
#

menu "host libdrm unittest menu"

config HOST_UNITTEST_LIBDRM
    bool "host libdrm unittest"
    select LIBDRM
    default n
    help
      host libdrm unittest

choice
    prompt "host libdrm unittest demo"
    depends on X86_64 && UNITTEST && HOST_UNITTEST_LIBDRM
    default HOST_LIBDRM_UNKNOWN

    config HOST_LIBDRM_DISP
        bool "host libdrm display unittest demo"
        select MEDIA_API

    config HOST_LIBDRM_UNKNOWN
        bool "host libdrm unittest unknow demo"

endchoice

endmenu
```

## project/unittest/host/live555/Kconfig
```kconfig
#
# live555 Kconfig
#

menu "live555 Examples"

config HOST_UNITTEST_LIVE555
    bool "host live555 unittest"
    default n
    help
      host live555 unittest

choice
    depends on X86_64 && UNITTEST && HOST_UNITTEST_LIVE555
    prompt "host live555 unittest demo"
    default HOST_LIVE555_UNK

    config HOST_LIVE555_RTSP_CLIENT
        bool "RTSP Client"
        select LIVE555

    config HOST_LIVE555_RTSP_SERVER
        bool "RTSP Server"
        select LIVE555

    config HOST_LIVE555_UNK
        bool "Unknown"

endchoice

endmenu
```

## project/unittest/host/qtcore/Kconfig
```kconfig
#
# host qtcore unittest Kconfig
#

menu "host qtcoreunittest menu"

config HOST_UNITTEST_QTCORE
    bool "host qtcore unittest"
    default n
    select QTCORE
    help
      host qtcore unittest

choice
    prompt "host qtcore unittest demo"
    depends on X86_64 && UNITTEST && HOST_UNITTEST_QTCORE
    default HOST_QTCORE_UNKNOWN

    config HOST_QTCORE_UNKNOWN
        bool "host qtcore unittest unknow demo"

endchoice

endmenu
```

## project/unittest/host/rtsp/Kconfig
```kconfig
#
# RTSP Kconfig
#

menu "rtsp example"

config HOST_UNITTEST_RTSP
    bool "host rtsp unittest"
    default n
    help
      host rtsp unittest

choice
    depends on X86_64 && UNITTEST && HOST_UNITTEST_RTSP
    prompt "host rtsp unittest demo"
    default HOST_RTSP_UNK

    config HOST_RTSP_CLIENT
        select RTSP
        bool "rtsp client unittest"

    config HOST_RTSP_SERVER
        select RTSP
        bool "rtsp server unittest"

    config HOST_RTSP_UNK
        bool "rtsp Unknown"

endchoice

endmenu
```

## project/unittest/host/signalslot/Kconfig
```kconfig
#
# host signal-slot unittest Kconfig
#

menu "host signal-slot unittest menu"

config HOST_UNITTEST_SIGSLOT
    bool "host signal slot unittest"
    default n
    help
      host signal slot unittest

choice
    prompt "host signal-slot unittest demo"
    depends on X86_64 && UNITTEST && HOST_UNITTEST_SIGSLOT
    default HOST_SIGSLOT_UNKNOWN

    config HOST_SIGNAL_SLOTS
        bool "host signal slots unittest demo"

    config HOST_SIGSLOT_UNKNOWN
        bool "host signal-slot unittest unknow demo"

endchoice

endmenu
```

## project/unittest/rockchip/Kconfig
```kconfig
#
# rockchip unittest Kconfig
#

source "project/unittest/rockchip/rv11xx/Kconfig"
```

## project/unittest/rockchip/rv11xx/Kconfig
```kconfig
#
# rockchip rv11xx Kconfig
#

menu "rockchip rv11xx unittest menu"

choice
    prompt "rockchip rv11xx unittest demo"
    depends on ROCKCHIP && UNITTEST && RV11XX
    default ROCKCHIP_RV11XX_UNKNOWN

    config ROCKCHIP_RV11XX_LIBDRM
        bool "rockchip rv11xx unittest libdrm demo"
        select MEDIA_API

    config ROCKCHIP_RV11XX_CAMERA_LIBDRM
        bool "rockchip rv11xx unittest camera libdrm demo"
        select MEDIA_API

    config ROCKCHIP_RV11XX_UNKNOWN
        bool "rockchip rv11xx unittest unknow demo"

endchoice

endmenu
```
