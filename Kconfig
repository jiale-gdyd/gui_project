## Kconfig
```kconfig
#
# For a description of the syntax of this configuration file
#

mainmenu "Application $APPVERSION Configuration"

config APPVERSION
    string
    option env="APPVERSION"

# source "lib/Kconfig"
source "project/Kconfig"
```

## project/3rdparty/Kconfig
```kconfig
#
# 3rdparty Kconfig
#

menu "Third party libraries"

source "project/3rdparty/source/Kconfig"

endmenu
```

## project/3rdparty/source/hope/Kconfig
```kconfig
#
# Hope Kconfig
#

menu "Hope"

config HOPE
    bool "A simple pure cplusplus event loop with signals and slots"
    default n
    help
      A simple pure cplusplus event loop with signals and slots

endmenu
```

## project/3rdparty/source/libv4l/Kconfig
```kconfig
#
# v4l-utils Kconfig
#

menu "v4l-utils"

config LIBV4L
    bool "v4l-utils"
    default n
    help
      Linux utilities and libraries to handle media devices (TV devices, capture devices, radio devices, remote controllers).

choice
    prompt "v4l version"
    depends on LIBV4L
    default LIBV4L2

    config LIBV4L1
        bool "v4l version 1"

    config LIBV4L2
        bool "v4l version 2"

endchoice

endmenu
```

## project/3rdparty/source/live555/Kconfig
```kconfig
#
# Live555 Kconfig
#

menu "live555"

config LIVE555
    bool "live555"
    default n
    help
      nternet Streaming Media, Wireless, and Multicast technology, services, & standards

config LIVE555_OPENSSL
    bool "live555 with openssl"
    depends on LIVE555
    default n
    help
      enable live555 with openssl

endmenu
```

## project/3rdparty/source/media/Kconfig
```kconfig
#
# media Kconfig
#

menu "Media application interface"

config MEDIA_API
    bool "Media application interface"
    default n
    select LIBDRM
    select LIBV4L
    select LIBV4L2
    help
      Media application interface

config RKMPP_HWOSD
    bool "RKMPP interface use hardware osd"
    default n
    depends on RKRGA
    help
      rkmpp interface use hardware osd

config RKMPP_RGA_OSD
    bool "RKMPP interface use rga osd"
    default n
    depends on RKRGA
    help
      rkmpp interface use rga osd

config RKAIQ
    bool "enable rockchip aiq"
    default n
    depends on ROCKCHIP
    help
      rockchip aiq

endmenu
```

## project/3rdparty/source/qtcore/Kconfig
```kconfig
#
# QtCore Kconfig
#

menu "QtCore application interface"

config QTCORE
    bool "QtCore application interface"
    default n
    help
      QtCore application interface

endmenu
```

## project/3rdparty/source/rkrga/Kconfig
```kconfig
#
# rkrga Kconfig
#

menu "rockchip Raster Graphic Acceleration Unit"

config RKRGA
    bool "Raster Graphic Acceleration Unit"
    default n
    depends on ROCKCHIP
    help
      Raster Graphic Acceleration Unit

endmenu
```

## project/3rdparty/source/rockchip/Kconfig
```kconfig
source "project/3rdparty/source/rockchip/rkrga/Kconfig"
source "project/3rdparty/source/rockchip/rkmpp/Kconfig"
```

## project/3rdparty/source/rockchip/rkmpp/Kconfig
```kconfig
#
# rkmpp Kconfig
#

menu "rockchip Media Process Platform"

config RKMPP
    bool "rockchip Media Process Platform"
    default n
    depends on ROCKCHIP
    help
      Media Process Platform

config RKMPP_MPEG2D
    bool "rockchip Media Process Platform mpeg2 decoder"
    depends on RKMPP
    default y
    help
      rockchip Media Process Platform mpeg2 decoder

config RKMPP_MPEG4D
    bool "rockchip Media Process Platform mpeg4 decoder"
    depends on RKMPP
    default y
    help
      rockchip Media Process Platform mpeg4 decoder

config RKMPP_H263D
    bool "rockchip Media Process Platform h263 decoder"
    depends on RKMPP
    default y
    help
      rockchip Media Process Platform h263 decoder

config RKMPP_H264D
    bool "rockchip Media Process Platform h264 decoder"
    depends on RKMPP
    default y
    help
      rockchip Media Process Platform h264 decoder

config RKMPP_H265D
    bool "rockchip Media Process Platform h265 decoder"
    depends on RKMPP
    default y
    help
      rockchip Media Process Platform h265 decoder

config RKMPP_VP8D
    bool "rockchip Media Process Platform vp8 decoder"
    depends on RKMPP
    default y
    help
      rockchip Media Process Platform vp8 decoder

config RKMPP_VP9D
    bool "rockchip Media Process Platform vp9 decoder"
    depends on RKMPP
    default y
    help
      rockchip Media Process Platform vp9 decoder

config RKMPP_AVSD
    bool "rockchip Media Process Platform avs decoder"
    depends on RKMPP
    default y
    help
      rockchip Media Process Platform avs decoder

config RKMPP_AVS2D
    bool "rockchip Media Process Platform avs2 decoder"
    depends on RKMPP
    default y
    help
      rockchip Media Process Platform avs2 decoder

config RKMPP_JPEGD
    bool "rockchip Media Process Platform jpeg decoder"
    depends on RKMPP
    default y
    help
      rockchip Media Process Platform jpeg decoder

config RKMPP_AV1D
    bool "rockchip Media Process Platform av1 decoder"
    depends on RKMPP
    default y
    help
      rockchip Media Process Platform av1 decoder

config RKMPP_H264E
    bool "rockchip Media Process Platform h264 encoder"
    depends on RKMPP
    default y
    help
      rockchip Media Process Platform h264 encoder

config RKMPP_JPEGE
    bool "rockchip Media Process Platform jpeg encoder"
    depends on RKMPP
    default y
    help
      rockchip Media Process Platform jpeg encoder

config RKMPP_H265E
    bool "rockchip Media Process Platform h265 encoder"
    depends on RKMPP
    default y
    help
      rockchip Media Process Platform h265 encoder

config RKMPP_VP8E
    bool "rockchip Media Process Platform vp8 encoder"
    depends on RKMPP
    default y
    help
      rockchip Media Process Platform vp8 encoder

config FASTPLAY_ONCE
    bool "enable fastplat once"
    depends on RKMPP
    default n
    help
      enable fastplat once

endmenu
```

## project/3rdparty/source/rockchip/rkrga/Kconfig
```kconfig
#
# rkrga Kconfig
#

menu "rockchip Raster Graphic Acceleration Unit"

config RKRGA
    bool "Raster Graphic Acceleration Unit"
    default n
    select LIBDRM
    depends on ROCKCHIP
    help
      Raster Graphic Acceleration Unit

choice
    prompt "Rockchip Raster Graphic Acceleration Unit version"
    depends on RKRGA
    default RKRGA_OLD

    config RKRGA_OLD
        bool "old version Raster Graphic Acceleration Unit"

    config RKRGA_NEW
        bool "new version Raster Graphic Acceleration Unit"
endchoice

endmenu
```

## project/3rdparty/source/rtsp/Kconfig
```kconfig
#
# RTSP Kconfig
#

menu "RTSP Server and Client"

config RTSP
    bool "implementation rtsp server and client"
    default n
    help
      Implementation rtsp server and client

config SIMPLE_RTSP_SERVER
    bool "simple rtsp server with c language"
    default n
    depends on RTSP
    help
      Enable simple rtsp server.

endmenu
```

## project/Kconfig
```kconfig
#
# Project Kconfig
#

source "project/gui/Kconfig"
source "project/entry/Kconfig"
source "project/3rdparty/Kconfig"
source "project/platform/Kconfig"
source "project/unittest/Kconfig"
```

## project/entry/Kconfig
```kconfig
#
# Entry Kconfig
#

menu "Application Entry Process"

config CHILD_PROCESS
    bool "Child Process"
    default n
    help
        This option enables the child process.

config PARENT_PROCESS
    bool "Parent Process"
    default y
    help
        This option enables the parent process.

endmenu
```
